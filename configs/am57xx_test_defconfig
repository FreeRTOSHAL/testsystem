## src/Kconfig
```kconfig
if MACH_VF610=y
source src/vf610/Kconfig
endif
if MACH_STM32=y
source src/stm32/Kconfig
endif
if MACH_IMX6=y
source src/imx6/Kconfig
endif
if MACH_AM57xx
source src/am57xx/Kconfig
endif
if ARCH_X86_LINUX
source src/linux/Kconfig
endif
if MACH_S32K
source src/s32k/Kconfig
endif
if MACH_C28X
source src/c28x/Kconfig
endif
if MACH_RISCV_QEMU
source src/riscv-qemu/Kconfig
endif
if MACH_POLARFIRE
source src/polarfire/Kconfig
endif
if MACH_KV4X
source src/kv4x/Kconfig
endif
```

## src/am57xx/Kconfig
```kconfig
menu "Application Config"
config APP_INCLUDE
	string
	default "-Iinclude/am57xx"
config RPROC_TEST
	bool "Remoteproc Test"
	default n
config MAILBOX_TEST
	bool "Mailbox Test"
	default n
config BOARD_TEST
	bool "Carolo Cub Board Test"
	default n
config PRINT_CLOCK_TREE
	bool "Print Clock Tree Register"
	default n
config SPI_TEST
	bool "Spi Test"
	depends on SPI
	default n
config TIMER_TEST
	bool "Timer Test"
	depends on TIMER
	default n
config MPU_TEST
	bool "MPU Test"
	depends on MPU9250
	default n 
config RTC_SOFTWARE_TEST
	bool "RTC Software Test"
	depends on RTC_SOFTWARE
	default n
config SOFTWARE_CAPTURE_TEST
	bool "Software Capture Test"
	depends on CAPTURE_SOFTWARE
	default n
config CAN_TEST
    bool "CAN Test"
    depends on CAN
    default n
config CAN_DISABLE
	bool "Disable CAN"
	help
		set CAN TX to high
endmenu
```

## src/c28x/Kconfig
```kconfig
menu "Application Config"
config APP_INCLUDE
	string
	default "-Iinclude/c28x"
config CAN_TEST
	bool "CAN Test"
	default n
if CAN_TEST=y
    config CAN_TEST_BITRATE
        int "CAN bitrate"
        default 500000
	config CAN_TEST_TOGGLE_PIN
		bool "Toggle TX Pins"
	config CAN_TEST_SEND
		bool "Send message"
	config CAN_TEST_RECV
		bool "Receive message"
	config CAN_TEST_ECHO
		bool "Receive message and send it back"
    if CAN_TEST_ECHO=y
	config CAN_TEST_ECHO_QUEUE_LENGTH
		int "Length of the queue of the received messages"
        default 4
    endif
endif
config CAN_DISABLE
	bool "Disable CAN"
	help
		set CAN TX to high
config EPWN_TEST
	bool "EPWN Test"
	default y
endmenu
```

## src/imx6/Kconfig
```kconfig
menu "Application Config"
config APP_INCLUDE
	string
	default "-Iinclude/imx6"
config MAILBOX_TEST
	bool "Mailbox Test"
	default n
config RPROC_TEST
	bool "Remoteproc Test"
	default n
config PHY_TEST
	bool "Phy Test"
	depends on !IMX_ENET
	default n
config ENET_TEST
	bool "ENet Test"
	depends on IMX_ENET
	default n
endmenu
```

## src/kv4x/Kconfig
```kconfig
menu "Application Config"
config APP_INCLUDE
	string
	default "-Iinclude/kv4x"
choice
	prompt "stdout UART"
	depends on UART
	help
		Select default UART
	config KV4X_STDOUT_SEMIHOSTING
		bool "Semihosting UART"
		depends on SEMIHOSTING_UART
endchoice
config CAN_TEST
	bool "CAN Test"
	depends on CAN
	config FLEXCAN_ECHO_TEST
		bool "Echo test"
		depends on CAN_TEST
		default n
config TIMER_KV4X_TEST
	bool "Flextimer Test"
	depends on MACH_KV4X_FLEXTIMER
	choice
		prompt "Timer Test"
		depends on TIMER_KV4X_TEST
		config TIMER_TEST_KV4X_ONESHOT
			bool "Use One Shot Mode"
		config TIMER_TEST_KV4X_PERIODIC
			bool "Use Periodic Mode"
		config TIMER_TEST_KV4X_PWM
			depends on PWM
			bool "Use PWM"
	endchoice
	config CAPTURE_KV4X_TEST
		depends on CAPTURE
		depends on TIMER_KV4X_TEST
		bool "Capture Test"
endmenu
```

## src/linux/Kconfig
```kconfig
menu "Application Config"
config APP_INCLUDE
	string
	default "-Iinclude/linux"
config ADC_TEST_TASK
	bool "ADC Test Task"
	depends on ADC_TEST
	default n
endmenu
```

## src/lpc8xx/Kconfig
```kconfig
menu "Application Config"
config APP_INCLUDE
	string
	default "-Iinclude/lpc8xx"
config GPIOTEST
	bool "GPIO Test"
	default n
	depends on GPIO
	help
		GPIO test
endmenu
```

## src/polarfire/Kconfig
```kconfig
menu "Application Config"
config APP_INCLUDE
	string
	default "-Iinclude/polarfire"
choice
	prompt "stdout UART"
	depends on UART
	help
		Select default UART
	config POLAFIRE_SBI_STDOUT_UART
		bool "SBI UART"
		depends on ARCH_SBI_UART
endchoice
#config UART_TEST
#	bool "UART Test"
#	default n
#config TIMER_TEST
#	bool "Timer Test"
#	default n
config FLOAT_TEST
	bool "Float Test"
	default n
endmenu
```

## src/riscv-qemu/Kconfig
```kconfig
menu "Application Config"
config APP_INCLUDE
	string
	default "-Iinclude/riscv-qemu"
choice
	prompt "stdout UART"
	depends on UART
	help
		Select default UART
	config QEMU_RISCV_STDOUT_UART0
		bool "UART 0"
		depends on MACH_NS16550
	config SBI_STDOUT_UART
		bool "SBI UART"
		depends on ARCH_SBI_UART
endchoice
config UART_TEST
	bool "UART Test"
	default n
config TIMER_TEST
	bool "Timer Test"
	default n
config FLOAT_TEST
	bool "Float Test"
	default n
endmenu
```

## src/s32k/Kconfig
```kconfig
menu "Application Config"
config APP_INCLUDE
	string
	default "-Iinclude/s32k"
choice
	prompt "stdout UART"
	depends on UART
	help
		Select default UART
	config S32K_STDOUT_SEMIHOSTING
		bool "Semihosting (over JTAG)"
		select ARCH_ARM_DEBUG
		select SEMIHOSTING
		select SEMIHOSTING_UART
	config S32K_STDOUT_UART0
		bool "LPUART 0"
		depends on MACH_S32K_LPUART0
	config S32K_STDOUT_UART1
		bool "LPUART 1"
		depends on MACH_S32K_LPUART1
	config S32K_STDOUT_UART2
		bool "LPUART 2"
		depends on MACH_S32K_LPUART2
endchoice
choice
	prompt "Test Board"
	config S32K144_BASE
		bool "S32K144 Base without GPIO and UART"
		depends on S32K144
	config S32K144_EVM
		bool "S32K144_EVM"
		depends on S32K144
	config S32K142_BMS_TEST_R0
		bool "S32K142 BMS Master Testboard (Brand) r0"
		depends on S32K142
	config S32K142_BMS_TEST_LUCA
		bool "S32K142 BMS Master Testboard (LOCA) r0"
		depends on S32K142
endchoice
config LPUART_TEST
	bool "lpuart Test"
	depends on MACH_S32K_LPUART1
	depends on !S32K_STDOUT_UART1
config TIMER_TEST
	bool "Flextimer Test"
	depends on MACH_S32K_FLEXTIMER
	choice
		prompt "Timter Test"
		depends on TIMER_TEST
		config TIMER_TEST_ONESHOT
			depends on TIMER_TEST
			bool "Use One Shot Mode"
		config TIMER_TEST_PERIODIC
			bool "Use Periodic Mode"
		config TIMER_TEST_PWM
			depends on TIMER_TEST
			depends on PWM
			bool "Use PWM"
	endchoice
		config CAPTURE_TEST
			depends on CAPTURE
			depends on TIMER_TEST
			bool "Capture Test"
config SPI_TEST
	bool "SPI Test"
	depends on SPI
	config SPI_TEST_SINGEL_BYTE
		bool "Test Singel Byte access"
		depends on SPI_TEST
		default n

config LTC6811_TEST
	bool "LTC6811 Test"
	depends on SPI
	depends on LTC6811

config CAN_TEST
	bool "CAN Test"
	depends on CAN
endmenu
```

## src/stm32/Kconfig
```kconfig
menu "Application Config"
config APP_INCLUDE
	string
	default "-Iinclude/stm32"
config TIMER_TEST
	bool "Timer Test"
	depends on TIMER
	default n
choice
	prompt "stdout UART"
	depends on UART
	help
		Select default UART
	config STDOUT_UART1
		bool "UART 1"
		depends on STM32_UART_1
	config STDOUT_UART2
		bool "UART 2"
		depends on STM32_UART_2
	config STDOUT_SEMIHOSTING
		bool "Semihosting (over JTAG)"
		select ARCH_ARM_DEBUG
		select SEMIHOSTING
		select SEMIHOSTING_UART
endchoice
choice
	prompt "Test Board"
	config NUCLEO
		bool "Nucleo"
	config PHOTON
		bool "Photon"
	config DISCOVERY
		bool "Discovery"
endchoice
config SDTEST
	bool "SD Test"
	default n
	depends on SD
	help 
		SD Test
config CAROLO_BOARD_TEST
	bool "Caolo Board Test"
	default n
	depends on GPIO
	help
		Carolo Base Board Test
endmenu
```
